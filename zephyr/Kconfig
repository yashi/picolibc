## zephyr/Kconfig
```kconfig
# Copyright (c) 2021 Space Cubics, LLC.
# SPDX-License-Identifier: Apache-2.0

config PICOLIBC
	bool "Enable Picolibc Support"
	help
	  This option enables the Picolibc library.
```
